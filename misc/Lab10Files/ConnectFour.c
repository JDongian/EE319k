// ConnectFour.c
// Runs with Logo starter file
// Jonathan Valvano
// November 29, 2012


/* This example accompanies the books
   "Embedded Systems: Real Time Interfacing to Arm Cortex M Microcontrollers",
   ISBN: 978-1463590154, Jonathan Valvano, copyright (c) 2012
   
   "Embedded Systems: Introduction to Arm Cortex M Microcontrollers",
   ISBN: 978-1469998749, Jonathan Valvano, copyright (c) 2012
 Copyright 2012 by Jonathan W. Valvano, valvano@mail.utexas.edu
    You may use, edit, run or distribute this file
    as long as the above copyright notice remains
 THIS SOFTWARE IS PROVIDED "AS IS".  NO WARRANTIES, WHETHER EXPRESS, IMPLIED
 OR STATUTORY, INCLUDING, BUT NOT LIMITED TO, IMPLIED WARRANTIES OF
 MERCHANTABILITY AND FITNESS FOR A PARTICULAR PURPOSE APPLY TO THIS SOFTWARE.
 VALVANO SHALL NOT, IN ANY CIRCUMSTANCES, BE LIABLE FOR SPECIAL, INCIDENTAL,
 OR CONSEQUENTIAL DAMAGES, FOR ANY REASON WHATSOEVER.
 For more information about my classes, my research, and my books, see
 http://users.ece.utexas.edu/~valvano/
 */
#include "hw_types.h"
#include "sysctl.h"
#include "lm3s1968.h"
#include "rit128x96x4.h"
#include "logo.h"


void DisableInterrupts(void); // Disable interrupts
void EnableInterrupts(void);  // Enable interrupts
long StartCritical (void);    // previous I bit, disable interrupts
void EndCritical(long sr);    // restore I bit to previous value
void WaitForInterrupt(void);  // low power mode

// which delays 3*ulCount cycles
#ifdef __TI_COMPILER_VERSION__
	//Code Composer Studio Code
	void Delay(unsigned long ulCount){
	__asm (	"    subs    r0, #1\n"
			"    bne     Delay\n"
			"    bx      lr\n");
}

#else
	//Keil uVision Code
	__asm void
	Delay(unsigned long ulCount)
	{
    subs    r0, #1
    bne     Delay
    bx      lr
	}

#endif
// 16-color BMP file format
// index 18-21 little endian is the width
// index 22-25 little endian is the height
// starting with index 0x76 and going to the second to last byte is the matrix data 4 bits/pixel
// the width is not a multiple of 16, then padding occurs so the number of bytes in each row is divisible by 8

const unsigned char Logo3[] ={
 0x42, 0x4D, 0xEE, 0x0F, 0x00, 0x00, 0x00, 0x00, 0x00, 0x00, 0x76, 0x00, 0x00, 0x00, 0x28, 0x00, 0x00, 0x00, 
 0x72, 0x00, 0x00, 0x00,   // width 0x72 = 114
 0x42, 0x00, 0x00, 0x00,   // height 0x42 = 66
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 0x00, 0x00, 0x00, 0x00, 0x00, 0x00, 0x00, 0x00, 0x00, 0x00, 0x00, 0x00, 0x00, 0x00, 0xFF,

};


const unsigned char Red[] ={
 0x42, 0x4D, 0xF6, 0x00, 0x00, 0x00, 0x00, 0x00, 0x00, 0x00, 0x76, 0x00, 0x00, 0x00, 0x28, 0x00, 0x00, 0x00, 
 0x10, 0x00, 0x00, 0x00, // width 16
 0x10, 0x00, 0x00, 0x00, // height 16
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 0xFF,

};
const unsigned char Yellow[] ={
 0x42, 0x4D, 0xF6, 0x00, 0x00, 0x00, 0x00, 0x00, 0x00, 0x00, 0x76, 0x00, 0x00, 0x00, 0x28, 0x00, 0x00, 0x00, 
 0x10, 0x00, 0x00, 0x00, // width 16
 0x10, 0x00, 0x00, 0x00, // height 16
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0xFF,

};

const unsigned char Blank[] ={
 0x42, 0x4D, 0xF6, 0x00, 0x00, 0x00, 0x00, 0x00, 0x00, 0x00, 0x76, 0x00, 0x00, 0x00, 0x28, 0x00, 0x00, 0x00,
 0x10, 0x00, 0x00, 0x00, // width 16
 0x10, 0x00, 0x00, 0x00, // height 16
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 0xFF,

};

const unsigned char Blue[] ={
 0x42, 0x4D, 0xF6, 0x00, 0x00, 0x00, 0x00, 0x00, 0x00, 0x00, 0x76, 0x00, 0x00, 0x00, 0x28, 0x00, 0x00, 0x00, 
 0x10, 0x00, 0x00, 0x00, // width 16
 0x10, 0x00, 0x00, 0x00, // height 16
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 0xFF,

};


const unsigned char Black[] ={
 0x42, 0x4D, 0xF6, 0x00, 0x00, 0x00, 0x00, 0x00, 0x00, 0x00, 0x76, 0x00, 0x00, 0x00, 0x28, 0x00, 0x00, 0x00, 
 0x10, 0x00, 0x00, 0x00, // width 16
 0x10, 0x00, 0x00, 0x00, // height 16
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 0xFF,
};




int main(void){int i,j; 
  SysCtlClockSet(SYSCTL_SYSDIV_4 | SYSCTL_USE_PLL | SYSCTL_OSC_MAIN | SYSCTL_XTAL_8MHZ);
  RIT128x96x4Init(1000000);
  // show the marquee
  RIT128x96x4_BMP(4, 86, Logo3);
  Delay(50000000);        // delay 3 sec at 50 MHz
  RIT128x96x4Clear();

  for(i=0; i<7; i++){  // top row is black
    RIT128x96x4_BMP(i*16, 16, Black);
  }
  for(i=0; i<7; i++){
    for(j=2; j<7; j++){
      RIT128x96x4_BMP(i*16, j*16, Blank);
    }
  }
  for(i=6;i>0;i--){
    RIT128x96x4_BMP(i*16, 16, Yellow);
     Delay(5000000);        // delay .3 sec at 50 MHz
     RIT128x96x4_BMP(i*16, 16, Black);
  }
  for(j=2;j<6;j++){
    RIT128x96x4_BMP(16, 16*j, Yellow);
    Delay(5000000);        // delay .3 sec at 50 MHz
    RIT128x96x4_BMP(16, 16*j, Blank);
  }
  RIT128x96x4_BMP(16, 16*6, Yellow);
  Delay(50000000);        // delay 3 sec at 50 MHz
  for(i=6;i>1;i--){
    RIT128x96x4_BMP(i*16, 16, Blue);
    Delay(5000000);        // delay .3 sec at 50 MHz
    RIT128x96x4_BMP(i*16, 16, Black);
  }
  for(j=2;j<6;j++){
    RIT128x96x4_BMP(32, 16*j, Blue);
    Delay(5000000);        // delay .3 sec at 50 MHz
    RIT128x96x4_BMP(32, 16*j, Blank);
  }
  RIT128x96x4_BMP(32, 16*6, Blue);
  Delay(500000000);        // delay 30 sec at 50 MHz 
  RIT128x96x4Clear();
  while(1){

  }
}

